## Kconfig
```kconfig
menu "COBS"

    config COBS
    bool "Enable COBS library"

    config COBS_STREAM
    bool "Enable COBS for data streams"

endmenu
```

## tests/cobs/testcase.yaml
```yaml
tests:
  libraries.cobs:
    min_flash: 34
    tags: cobs
    integration_platforms:
      - native_posix
```
